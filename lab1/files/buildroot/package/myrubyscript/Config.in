## lab1/files/buildroot/package/myrubyscript/Config.in
```kconfig
config BR2_PACKAGE_MYRUBYSCRIPT
	bool "myrubyscript"
	depends on BR2_PACKAGE_RUBY
	help
	  Example Ruby script added to Buildroot
	  for exercise purposes.

	  https://www.ruby-lang.org/

comment "myrubyscript needs ruby"
	depends on !BR2_PACKAGE_RUBY
```

## lab2/files/package/simon/Config.in
```kconfig
config BR2_PACKAGE_SIMON
	bool "simon"
	help
	  A simpler version of the electronic game
	  Simon, using LEDs and microswitches connected
	  via GPIO.

	  https://github.com/bdach
```

## lab3/files/user/package/uwsgi/Config.in
```kconfig
config BR2_PACKAGE_UWSGI
	bool "uwsgi"
    select BR2_PACKAGE_LIBXML2
	help
        The uWSGI project aims at developing a full stack for building hosting services.
        https://uwsgi-docs.readthedocs.org/en/latest/
```
